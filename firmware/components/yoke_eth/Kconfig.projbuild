## firmware/components/yoke_eth/Kconfig.projbuild
```kconfig
menu "Yoke Ethernet board profile (pins bench-unverified)"

choice YOKE_ETH_INTERFACE
    prompt "Ethernet controller"
    default YOKE_ETH_EMAC if IDF_TARGET_ESP32P4
    default YOKE_ETH_W5500

config YOKE_ETH_W5500
    bool "WIZnet W5500 on SPI2 (ESP32-S3 boards, W5500 modules)"
    depends on ETH_SPI_ETHERNET_W5500

config YOKE_ETH_EMAC
    bool "Internal EMAC with an IP101 RMII PHY (ESP32-P4 boards)"
    depends on ETH_USE_ESP32_EMAC && IDF_TARGET_ESP32P4
    help
        RMII data and clock pins are ESP-IDF's ESP32-P4 defaults (TX_EN 49,
        TXD0 34, TXD1 35, CRS_DV 28, RXD0 29, RXD1 30, 50 MHz clock in on
        GPIO 50), the ESP32-P4-Function-EV-Board and Waveshare
        ESP32-P4-ETH layout. Check the schematic of any other board.

endchoice

config YOKE_ETH_MOSI
    int "W5500 MOSI GPIO"
    depends on YOKE_ETH_W5500
    default 11
config YOKE_ETH_MISO
    int "W5500 MISO GPIO"
    depends on YOKE_ETH_W5500
    default 12
config YOKE_ETH_SCLK
    int "W5500 clock GPIO"
    depends on YOKE_ETH_W5500
    default 13
config YOKE_ETH_CS
    int "W5500 chip select GPIO"
    depends on YOKE_ETH_W5500
    default 14
config YOKE_ETH_INT
    int "W5500 interrupt GPIO"
    depends on YOKE_ETH_W5500
    default 10
config YOKE_ETH_SPI_MHZ
    int "W5500 SPI MHz"
    depends on YOKE_ETH_W5500
    range 1 40
    default 20

config YOKE_ETH_MDC
    int "PHY management clock (MDC) GPIO"
    depends on YOKE_ETH_EMAC
    default 31
config YOKE_ETH_MDIO
    int "PHY management data (MDIO) GPIO"
    depends on YOKE_ETH_EMAC
    default 52
config YOKE_ETH_PHY_ADDR
    int "PHY address"
    depends on YOKE_ETH_EMAC
    range 0 31
    default 1

config YOKE_ETH_RESET
    int "W5500 or PHY reset GPIO (-1: none)"
    default 51 if YOKE_ETH_EMAC
    default 9

config YOKE_STATIC_IPV4
    bool "Use static IPv4 instead of DHCP"
    default n
config YOKE_IP
    string "Static IPv4 address"
    depends on YOKE_STATIC_IPV4
    default "192.168.20.50"
config YOKE_MASK
    string "Static IPv4 netmask"
    depends on YOKE_STATIC_IPV4
    default "255.255.255.0"
config YOKE_GATEWAY
    string "Static IPv4 gateway (0.0.0.0 allowed)"
    depends on YOKE_STATIC_IPV4
    default "0.0.0.0"

endmenu
```

## firmware/esp32-usb/main/Kconfig.projbuild
```kconfig
menu "Yoke USB box"

choice YOKE_USB_ROLE
    prompt "Role until one is set over the admin API (NVS yoke_usb/role)"
    default YOKE_USB_ROLE_COMPUTER
    help
        Each box has one USB role per boot. Change it with
        PUT /v1/usb/config {"role": "device"} (mutual TLS); the box restarts.

config YOKE_USB_ROLE_DEVICE
    bool "device: USB host for the peripheral (device-side box)"

config YOKE_USB_ROLE_COMPUTER
    bool "computer: USB device toward the computer (computer-side box)"

endchoice

config YOKE_USB_NTP_SERVER
    string "NTP server (besides one from DHCP option 42)"
    default "pool.ntp.org"
    help
        YWP/1 pairing needs the real wall clock: peers drop frames whose
        sequence (Unix time) is far off. The box asks DHCP for an NTP
        server and also polls this one; empty: DHCP's only. Without either,
        set the clock over the admin API (PUT /v1/usb/clock).

endmenu
```

## firmware/esp32/components/yoke_ir/Kconfig
```kconfig
menu "Yoke IR endpoint (pins and polarity bench-unverified)"

config YOKE_IR_API_DEFAULT
    bool "Enable the unauthenticated iTach-subset API on TCP 4998 by default"
    default n
    help
        Cleartext and unauthenticated by design (iTach compatibility). Off by
        default; the NVS key yoke_ir/api (set over the mutual-TLS admin API)
        overrides this default. Peers must share the Ethernet subnet unless
        an explicit allowlist is configured.

config YOKE_IR_LEARNING_DEFAULT
    bool "Allow get_IRL learning by default"
    default n
    help
        Requires YOKE_IR_LEARN_GPIO. NVS key yoke_ir/learn overrides.

config YOKE_IR_OUTPUTS
    int "IR outputs (connectors 1:1..1:N, one RMT TX channel each)"
    range 1 4
    default 1

config YOKE_IR_GPIO_1
    int "Connector 1:1 GPIO"
    default 15

config YOKE_IR_GPIO_2
    int "Connector 1:2 GPIO"
    depends on YOKE_IR_OUTPUTS > 1
    default 16

config YOKE_IR_GPIO_3
    int "Connector 1:3 GPIO"
    depends on YOKE_IR_OUTPUTS > 2
    default 17

config YOKE_IR_GPIO_4
    int "Connector 1:4 GPIO"
    depends on YOKE_IR_OUTPUTS > 3
    default 18

config YOKE_IR_INVERT
    bool "Invert outputs (active-low emitter driver)"
    default n

config YOKE_IR_DUTY_PERCENT
    int "Carrier duty cycle percent"
    range 10 50
    default 33

config YOKE_IR_LEARN_GPIO
    int "Learning sensor GPIO (-1: no learning hardware)"
    range -1 48
    default -1

config YOKE_IR_MAX_CONNECTIONS
    int "Concurrent TCP 4998 connections"
    range 1 8
    default 4

config YOKE_IR_RATE_PER_S
    int "Sustained command lines per second per connection"
    range 1 1000
    default 20

config YOKE_IR_BURST
    int "Command line burst per connection"
    range 1 1000
    default 40

config YOKE_IR_MAX_FRAME_MS
    int "Longest single IR frame (ms)"
    range 100 4000
    default 2000

config YOKE_IR_SELFTEST_LOOPBACK
    bool "Boot self-test loops RMT output 1:1 back through an RX channel"
    default y
    help
        Emits three unmodulated pulses (40-120 us) on the 1:1 pin at boot.
        Without a carrier no IR receiver decodes them.

endmenu
```

## firmware/esp32/main/Kconfig.projbuild
```kconfig
menu "Yoke W5500 Ethernet reference board (bench-unverified)"
config YOKE_ETH_MOSI
    int "W5500 MOSI GPIO"
    default 11
config YOKE_ETH_MISO
    int "W5500 MISO GPIO"
    default 12
config YOKE_ETH_SCLK
    int "W5500 clock GPIO"
    default 13
config YOKE_ETH_CS
    int "W5500 chip select GPIO"
    default 14
config YOKE_ETH_INT
    int "W5500 interrupt GPIO"
    default 10
config YOKE_ETH_RESET
    int "W5500 reset GPIO"
    default 9
config YOKE_ETH_SPI_MHZ
    int "W5500 SPI MHz"
    range 1 40
    default 20
config YOKE_STATIC_IPV4
    bool "Use static IPv4 instead of DHCP"
    default n
config YOKE_IP
    string "Static IPv4 address"
    depends on YOKE_STATIC_IPV4
    default "192.168.20.50"
config YOKE_MASK
    string "Static IPv4 netmask"
    depends on YOKE_STATIC_IPV4
    default "255.255.255.0"
config YOKE_GATEWAY
    string "Static IPv4 gateway (0.0.0.0 allowed)"
    depends on YOKE_STATIC_IPV4
    default "0.0.0.0"
endmenu
```
