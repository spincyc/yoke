## firmware/zero3e/Config.in
```kconfig
menu "Yoke ZERO 3E appliance packages"
source "$BR2_EXTERNAL_YOKE_ZERO3E_PATH/package/yoke-gadget-worker/Config.in"
source "$BR2_EXTERNAL_YOKE_ZERO3E_PATH/package/yoke-app/Config.in"
endmenu
```

## firmware/zero3e/package/yoke-app/Config.in
```kconfig
config BR2_PACKAGE_YOKE_APP
	bool "yoke-app"
	depends on BR2_PACKAGE_PYTHON3
	select BR2_PACKAGE_YOKE_GADGET_WORKER
	help
	  Yoke control-plane agent, CLI, and ZERO 3E systemd/udev units.
```

## firmware/zero3e/package/yoke-gadget-worker/Config.in
```kconfig
config BR2_PACKAGE_YOKE_GADGET_WORKER
	bool "yoke-gadget-worker"
	depends on BR2_TOOLCHAIN_HAS_THREADS
	help
	  Yoke native C11 USB/IP to Linux Raw Gadget worker (ADR 0027).
	  Installs /usr/local/libexec/yoke/yoke-gadget-worker.
```
